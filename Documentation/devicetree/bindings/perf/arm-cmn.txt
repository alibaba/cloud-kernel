## Documentation/devicetree/bindings/perf/arm-cmn.txt
```
* ARM CMN (Coherent Mesh Network) Performance Monitor

** Required properties:

- compatible	: Should be "arm,cmn-600"

- reg		: Physical address of the base (PERIPHBASE) and size
		  (up to 64MB) of the configuration address space.

- interrupts	: PMU overflow interrupts, one per implemented DTC.

- arm,root-node	: Offset from PERIPHBASE of the configuration discovery
		  node (see TRM definition of ROOTNODEBASE).

Example:

	cmn@50000000 {
		compatible = "arm,cmn-600";
		reg = <0x0 0x50000000 0x0 0x4000000>;
		/* 4x2 mesh with one DTC, and CFG node at 0,1,1,0 */
		interrupts = <GIC_SPI 46 IRQ_TYPE_LEVEL_HIGH>;
		arm,root-node = <0x104000>;
	};
```

## drivers/infiniband/hw/erdma/Kconfig
```kconfig
# SPDX-License-Identifier: GPL-2.0 OR BSD-2-Clause
config INFINIBAND_ERDMA
	tristate "Elastic ERDMA support"
	depends on PCI_MSI && 64BIT && !CPU_BIG_ENDIAN && X86_64
	depends on INFINIBAND_USER_ACCESS
	help
	  This driver supports Alibaba Elastic RDMA Adapter (ERDMA).

	  To compile this driver as a module, choose M here.
	  The module will be called erdma.
```

## drivers/net/ethernet/huawei/hinic/Kconfig
```kconfig
#
# Huawei driver configuration
#

config HINIC
	tristate "Huawei Intelligent PCIE Network Interface Card"
	default n
	depends on PCI_MSI && NUMA && PCI_IOV && DCB
	---help---
	  This driver supports HiNIC PCIE Ethernet cards.
	  To compile this driver as part of the kernel, choose Y here.
	  If unsure, choose N.
	  The default is N.
```

## drivers/pci/iohub-sriov/Kconfig
```kconfig
# SPDX-License-Identifier: GPL-2.0
# #
# # PCI configuration
# #
#

menu "PCIe IOHub"

config PCI_IOHUB_SRIOV
	tristate "Alibaba PCIe IOHub SRIOV Driver"
	depends on PCI
	help
	  Enables support for Alibaba PCIe IOHub SRIOV Driver,
	  It enables SRIOV of PCIe devices of Alibaba MOC,
	  then VFs can be used by other applications.

endmenu
```

## drivers/perf/thead/Kconfig
```kconfig
#PDX-License-Identifier: GPL-2.0-only
#
# Performance Monitor Drivers for THead M1 chip
#
config THEAD_M1_PMU
    tristate "THead M1 SoC PMU drivers"
	depends on (ARM64 && ACPI)
	default m
	  help
	  Support for PMU events monitoring on Alibaba THead M1 SoC,
		includes CMN-700, DDR Subsystem, and PCIe Controller
```

## drivers/staging/gic_phytium_2500/Kconfig
```kconfig
config ARM_GIC_PHYTIUM_2500
       bool "Add phytium2500 chip gic support"
       depends on STAGING && ARCH_PHYTIUM
       select IRQ_DOMAIN
       select GENERIC_IRQ_MULTI_HANDLER
       select IRQ_DOMAIN_HIERARCHY
       select PARTITION_PERCPU
       select GENERIC_IRQ_EFFECTIVE_AFF_MASK
       select GENERIC_MSI_IRQ_DOMAIN
```

## kernel/livepatch/Kconfig
```kconfig
# SPDX-License-Identifier: GPL-2.0-only
config HAVE_LIVEPATCH
	bool
	help
	  Arch supports kernel live patching

config LIVEPATCH
	bool "Kernel Live Patching"
	depends on DYNAMIC_FTRACE_WITH_REGS
	depends on MODULES
	depends on SYSFS
	depends on KALLSYMS_ALL
	depends on HAVE_LIVEPATCH
	depends on !TRIM_UNUSED_KSYMS
	help
	  Say Y here if you want to support kernel live patching.
	  This option has no runtime impact until a kernel "patch"
	  module uses the interface provided by this option to register
	  a patch, causing calls to patched functions to be redirected
	  to new function code contained in the patch module.

choice
	prompt "live patch consistency model"
	depends on LIVEPATCH
	default LIVEPATCH_STOP_MACHINE_MODEL
	help
	  Livepatch consistency model configuration.
	  There are two kinds of consistency model for kernel hotfix:
	  1. stop machine model for Kpatch (Red Hat)
		2. per-task model for kGraft (SUSE)

config LIVEPATCH_PER_TASK_MODEL
	bool "per task consistency model"
	help
	  Use per-task consistency model
	  Kernel livepatch chooses per-task model to manage hotfix state
	  conistency. Howerver, per-task model is much complicated, and not
	  be widely verified on product environment.

config LIVEPATCH_STOP_MACHINE_MODEL
	bool "stop machine consistency model"
	help
	  Use stop machine consistency model
	  stop machine model is simple, less chances to make mistakes
	  stop machine model is widely used by Kpatch, which is proved to be
	  safe and robust enough.
endchoice
```

## net/hookers/Kconfig
```kconfig
config HOOKERS
       tristate "Hooker service"
       default m
	depends on X86
       help
       Allow replacing and restore the function pointer in any order.
       See include/linux/hookers.h for details.
```

## net/ipv4/tcp_rt/Kconfig
```kconfig
config TCP_RT_MODULE
	tristate "TCP-RT module"
	default m
	depends on TCP_RT
	help
	  This module depends on TCP-RT framework, collect the request
	  information on tcp and output by relay.
```
